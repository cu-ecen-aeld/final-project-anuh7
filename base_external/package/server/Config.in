## base_external/package/server/Config.in
```kconfig
config BR2_PACKAGE_SERVER
        bool "server"
        help
          Includes the writer executable, finder.sh and tester.sh in the kernel image.
          Used to understand buildroot external trees and package builds.
```
